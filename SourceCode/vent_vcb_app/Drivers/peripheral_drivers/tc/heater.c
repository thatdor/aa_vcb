/*
 * heater.c
 *
 *  Created on: Apr 15, 2024
 *      Author: dawei.zhou
 */
#include "main.h"
#include "cmsis_os.h"
#include "heater.h"

// 获取pt100温度
float heater_pt100_get_temperature_by_map(float resistance, float tmp_map_tbl[][2], uint32_t count)
{
    //int count = sizeof(tmp_map_tbl)/sizeof(tmp_map_tbl[0]);
    int low = 0;
    int high = count - 1;
    int mid = 0;
    float tmp = 0;

    if (resistance < tmp_map_tbl[0][0])
    {
        tmp = tmp_map_tbl[0][1] * 10;
    }
    else if (resistance > tmp_map_tbl[count-1][0])
    {
        tmp = tmp_map_tbl[count-1][1] * 10;
    }
    else
    {
        while(low <= high)
        {
            mid = (low + high) / 2;
            if (resistance > tmp_map_tbl[mid][0])
            {
                if (resistance < tmp_map_tbl[mid+1][0])
                {
                    tmp = tmp_map_tbl[mid][1] * 10 +
                            ((resistance - tmp_map_tbl[mid][0]) * 10) /
                            (tmp_map_tbl[mid+1][0] - tmp_map_tbl[mid][0]) *
                            (tmp_map_tbl[mid][1] - tmp_map_tbl[mid + 1][1])
                            ;
                    break;
                }
                low = mid + 1;
            }
            else if (resistance < tmp_map_tbl[mid][0])
            {
                if (resistance > tmp_map_tbl[mid-1][0])
                {
                    tmp = tmp_map_tbl[mid - 1][1] * 10 +
                                                ((tmp_map_tbl[mid - 1][0] - resistance) * 10) /
                                                (tmp_map_tbl[mid][0] - tmp_map_tbl[mid-1][0]) *
                                                (tmp_map_tbl[mid - 1][1] - tmp_map_tbl[mid][1]);
                    break;
                }
                high = mid - 1;
            }
            else // ==
            {
                tmp = tmp_map_tbl[mid][1] * 10;
                break;
            }
        }
    }
    return tmp;
}


void heater_ctrl(int pwm)
{
    HAL_TIM_PWM_Start(&htim4, TIM_CHANNEL_4);

    __HAL_TIM_SET_COMPARE(&htim4, TIM_CHANNEL_4, pwm);
}



void heater_clockrun(int16_t target_temp, int16_t current_temp)  // 0.1°C
{
    // r=10*((float)temp_adc/65535*4.096)/(3.3-(float)temp_adc/65535*4.096);
    static int pwm = 0;
    int16_t delta_pwm = (target_temp - current_temp) * 0.02;

    // 高于45度不再加热
    if ((current_temp > 450) && (delta_pwm > 0))
    {
        delta_pwm = 0;
    }

    pwm += delta_pwm;

    pwm = (pwm > 1000) ? 1000 : pwm;
    pwm = (pwm < 0   ) ? 0    : pwm;

    heater_ctrl(pwm);
}

//pt100
float g_heater_pt100_temperature_map_tbl[][2] = {
        { 92.44, -10 },
        { 92.84, -9 },
        { 93.24, -8 },
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        { 123.708, 60 }
};


float heater_pt100_get_temperature(float resistance)
{
    uint32_t count = sizeof(g_heater_pt100_temperature_map_tbl)/sizeof(g_heater_pt100_temperature_map_tbl[0]);

    return heater_pt100_get_temperature_by_map(resistance, g_heater_pt100_temperature_map_tbl, count);
}

